/******************************************************************************************
 *                                CPCESP Keyboard Firmware                               *
 *----------------------------------------------------------------------------------------*
 * Project:   Custom PS2 Keyboard for Amstrad CPC464 Emulator - CPCESP                    *
 * Author:    Archer                                                                      *
 * Date:      25/09/2024                                                                  *
 *----------------------------------------------------------------------------------------*
 * Description:                                                                           *
 * - Implements a custom PS2 keyboard firmware for the CPCESP emulator.                   *
 * - Uses the original Amstrad CPC464 keyboard matrix layout.                             *
 * - Includes an additional FN key to enable an extra layout tailored for the emulator.   *
 *                                                                                        *
 * Features:                                                                              *
 * - Full support for the Amstrad CPC464 original key mapping.                            *
 * - FN key functionality for alternate key layouts specific to the CPCESP emulator.      *
 * - Optimized for compatibility with standard PS2 keyboards.                             *
 *                                                                                        *
 ******************************************************************************************/
#include "ps2_lib.hpp"

#define VERSION 1.0

#define BYTE_SEND_WAIT 200

const uint8_t scancode[160] = {
  // Layout 1
  0x42, 0x43, 0x40, 0x41, 0x46, 0x47, 0x00, 0x66,
  0x16, 0x1E, 0x76, 0x15, 0x0D, 0x1C, 0x58, 0x1A,
  0x25, 0x26, 0x24, 0x1D, 0x1B, 0x23, 0x21, 0x22,
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  0x75, 0x74, 0x72, 0x46, 0x36, 0x26, 0x5A, 0x49,
  
  // Layout 2 (FN)
  0x00, 0x00, 0x00, 0x00, 0x00, 0x00, 0x00, 0x00,
  0x05, 0x06, 0x00, 0x00, 0x00, 0x00, 0x00, 0x00,
  0x0C, 0x04, 0x00, 0x00, 0x00, 0x00, 0x00, 0x00,
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  0x00, 0x00, 0x00, 0x00, 0x00, 0x00, 0x00, 0x00
};

const uint8_t scancode_extended[160] = {
  // Layout 1
  0xE2, 0xE2, 0xE2, 0xE2, 0xE2, 0xE2, 0xE2, 0x00,
  0x00, 0x00, 0x00, 0x00, 0x00, 0x00, 0x00, 0x00,
  0x00, 0x00, 0x00, 0x00, 0x00, 0x00, 0x00, 0x00,
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  0xE0, 0xE0, 0xE0, 0x00, 0x00, 0x00, 0xE0, 0x00,

  // Layout 2
  0x00, 0x00, 0x00, 0x00, 0x00, 0x00, 0x00, 0x00,
  0x00, 0x00, 0x00, 0x00, 0x00, 0x00, 0x00, 0x00,
  0x00, 0x00, 0x00, 0x00, 0x00, 0x00, 0x00, 0x00,
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  0x00, 0x00, 0x00, 0x00, 0x00, 0x00, 0x00, 0x00
};

bool key_status[80];

PS2 kbd;

void sendPS2Key(byte key_code) {
  uint8_t key_extended = scancode_extended[key_code];
  if (key_extended) {
    kbd.sendByte(key_extended);
    delayMicroseconds(BYTE_SEND_WAIT);
  }
  kbd.sendByte(scancode[key_code]);
}


void sendPS2BreakKey(byte key_code) {
  uint8_t key_extended = scancode_extended[key_code];
  if (key_extended) {
    kbd.sendByte(key_extended);
    delayMicroseconds(BYTE_SEND_WAIT);
  }
  kbd.sendByte(0xF0);
  delayMicroseconds(BYTE_SEND_WAIT);
  kbd.sendByte(scancode[key_code]);
}


void activeCol(int row) {
  uint16_t estado = 0x0001;
  estado <<= (9 - row);
  uint8_t portb_mask = estado & 0x3F;
  uint8_t portc_mask = (estado >> 6) & 0x0F;

  PORTC |= 0x0F;
  PORTB |= 0x3F;

  PORTC &= ~portc_mask;
  PORTB &= ~portb_mask;
}

unsigned char ledStatus = 0;


void setup() {
  delay(200);
  DDRB |= 0x3F;
  DDRC |= 0x0F;
  DDRD = 0x00;

  PORTB |= 0x3F;
  PORTC |= 0x0F;
  PORTD = 0xFF;

  pinMode(A6, INPUT);
  kbd.init();
}

void loop() {
  int fn_key_status = analogRead(A6);

  uint8_t fn_page = 0;
  if (fn_key_status > 512) {
    fn_page = 80;
  }

  if (kbd.available()) kbd.executeCommand();
 
  for (int row = 0; row < 10; row++) {
    int rowm = row * 8;
    activeCol(row);

    for (int col = 0; col < 8; col++) {
      uint8_t estadoPuertoD = PIND;
      uint8_t estadoInvertido = ~estadoPuertoD;
      uint8_t x_col = (estadoInvertido >> col) & 0x01;

      uint8_t offset = rowm + col;
      uint8_t scancode_offset = offset + fn_page;
      
      if (x_col) {
        if (!key_status[offset]) {
          sendPS2Key(scancode_offset);
          key_status[offset] = true;
        }
      } else {
        if (key_status[offset]) {
          sendPS2BreakKey(scancode_offset);
          key_status[offset] = false;
        }
      }
    }
  }
}
